#include <dt-bindings/zmk/matrix_transform.h> // Put this with the other includes at the top of your dtsi

/ {
    chosen {
        zmk, kscan = &kscan0;
        zmk,physical-layout = &default_transform;
        // Other chosen items
    };

    default_transform: keymap_transform0 {
        compatible = "zmk,matrix-transform";
        columns = <10>;
        rows = <5>
        map = <
        //  LKey 1 |LKey 2 |LKey 3 |LKey 4 |LKey 5    RKey 1 |RKey 2 |RKey 3 |RKey 4 |RKey 5
            RC(0,0) RC(0,1) RC(0,2) RC(0,3) RC(0,4)   RC(0,5) RC(0,6) RC(0,7) RC(0,8) RC(0,9)
        //  LKey 4 |LKey 5 |LKey 6      RKey 4 |RKey 5 |RKey 6
            RC(1,0) RC(1,1) RC(1,2) RC(1,3) RC(1,4)   RC(1,5) RC(1,6) RC(1,7) RC(1,8) RC(1,9)
        //  LKey 7 |LKey 8 |LKey 9      RKey 7 |RKey 8 |RKey 9
            RC(2,0) RC(2,1) RC(2,2) RC(2,3) RC(2,4)    RC(2,5) RC(2,6) RC(2,7) RC(2,8) RC(2,9)

            RC(3,0) RC(3,1) RC(3,2) RC(3,3) RC(3,4)    RC(3,5) RC(3,6) RC(3,7) RC(3,8) RC(3,9)

            RC(4,0) RC(4,1) RC(4,2) RC(4,3) RC(4,4)    RC(4,5) RC(4,6) RC(4,7) RC(4,8) RC(4,9)

        >;
    };

    
    kscan0: kscan0 {
        compatible = "zmk,kscan-gpio-matrix";
        diode-direction = "col2row";
        wakeup-source;

        row-gpios
            = <&pro_micro 21 GPIO_ACTIVE_HIGH>
            , <&pro_micro 20 GPIO_ACTIVE_HIGH>
            , <&pro_micro 19 GPIO_ACTIVE_HIGH>
            , <&pro_micro 18 GPIO_ACTIVE_HIGH>
            , <&pro_micro 15 GPIO_ACTIVE_HIGH>
            ;

    };
};
