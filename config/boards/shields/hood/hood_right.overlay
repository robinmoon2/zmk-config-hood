#include "hood.dtsi"

&default_transform {
    col-offset = <3>;
};

&kscan0 {
    col-gpios
        = <&pro_micro 8 GPIO_ACTIVE_HIGH>
        , <&pro_micro 9 GPIO_ACTIVE_HIGH>
        , <&pro_micro 10 GPIO_ACTIVE_HIGH>

        ;
};

&default_layout {
    kscan = <&kscan0>;
};