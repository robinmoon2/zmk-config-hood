## config/boards/shields/Kconfig.defconfig
```kconfig
if SHIELD_HOOD_LEFT

config ZMK_KEYBOARD_NAME
    default "HOOD"

config ZMK_SPLIT_ROLE_CENTRAL
    default y 

endif

if SHIELD_HOOD_LEFT || SHIELD_HOOD_RIGHT

    config ZMK_SPLIT
        default y

endif
```

## config/boards/shields/Kconfig.shield
```kconfig
# No whitespace after the comma or in your part name!
config SHIELD_CORNE_LEFT
    def_bool $(shields_list_contains,corne_left)

# No whitespace after the comma or in your part name!
config SHIELD_CORNE_RIGHT
    def_bool $(shields_list_contains,corne_right)
```

## config/boards/shields/hood/Kconfig.shield
```kconfig
# No whitespace after the comma or in your part name!
config SHIELD_HOOD_LEFT
    def_bool $(shields_list_contains,hood_left)

# No whitespace after the comma or in your part name!
config SHIELD_HOOD_RIGHT
    def_bool $(shields_list_contains,hood_right)
```
